## meta-myir/meta-rzt2h/conf/machine/myd-yt2h.conf
```bitbake
#@TYPE: Machine
#@NAME: rzt2h-dev machine
#@DESCRIPTION: RZ/T2H Evaluation Board platform

SOC_FAMILY = "r9a09g077"
require conf/machine/include/${SOC_FAMILY}.inc
require conf/machine/include/rzg2-common.inc
require conf/machine/include/cip-core.inc

DEFAULTTUNE ?= "cortexa55"

TUNE_CONF ?= "conf/machine/include/tune-cortexa55.inc"
require ${TUNE_CONF}

PREFERRED_PROVIDER_virtual/kernel="linux-renesas"


#UBOOT_CONFIG ??= "rzt2h-dev"
#UBOOT_CONFIG[rzt2h-dev] = "rzt2h-dev_defconfig"
UBOOT_CONFIG ??= "myc_rzt2h"
UBOOT_CONFIG[myc_rzt2h] = "myc_rzt2h_defconfig"

# Supported devicetree
KERNEL_DEVICETREE = " \
	renesas/r9a09g077m44-dev.dtb \
	myir/myb-yt2hx-display.dtb \
	myir/myb-yt2hx-fsp-a551-support.dtb \
	myir/myb-yt2hx-fsp-a552-support.dtb \
	myir/myb-yt2hx-fsp-a553-support.dtb \
"

IMAGE_BOOT_FILES = " \
	bl2_bp_xspi0-${MACHINE}.bin \
	bl2_bp_xspi1-${MACHINE}.bin \
	bl2_bp_emmc-${MACHINE}.bin \
	bl2_bp_esd-${MACHINE}.bin \
	fip-${MACHINE}.bin \
	bl2_bp_xspi0-${MACHINE}.srec \
	bl2_bp_xspi1-${MACHINE}.srec \
	bl2_bp_emmc-${MACHINE}.srec \
	fip-${MACHINE}.srec \
	myb-yt2hx-display.dtb \
   	myb-yt2hx-fsp-a551-support.dtb \
	myb-yt2hx-fsp-a552-support.dtb \
	myb-yt2hx-fsp-a553-support.dtb \
"

WIC_INPUT_DEPENDS = "trusted-firmware-a:do_deploy"
```

## meta-myir/meta-rzt2h/docs/template/conf/bblayers.conf.sample
```bitbake
# POKY_BBLAYERS_CONF_VERSION is increased each time build/conf/bblayers.conf
# changes incompatibly
POKY_BBLAYERS_CONF_VERSION = "2"

BBPATH = "${TOPDIR}"
BBFILES ?= ""

BBLAYERS ?= " \
  ${TOPDIR}/../meta-gplv2 \
  ${TOPDIR}/../poky/meta \
  ${TOPDIR}/../poky/meta-poky \
  ${TOPDIR}/../poky/meta-yocto-bsp \
  ${TOPDIR}/../meta-myir/meta-rz-common \
  ${TOPDIR}/../meta-myir/meta-rzt2h \
  ${TOPDIR}/../meta-openembedded/meta-oe \
  ${TOPDIR}/../meta-openembedded/meta-python \
  ${TOPDIR}/../meta-openembedded/meta-multimedia \
  ${TOPDIR}/../meta-qt5 \
  ${TOPDIR}/../meta-rz-features/meta-rz-demos \
  ${TOPDIR}/../meta-rz-multi-os \
  "
```
